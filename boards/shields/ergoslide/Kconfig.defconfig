## boards/shields/ergoslide/Kconfig.defconfig
```kconfig
if SHIELD_ERGOSLIDE_LEFT

# Name must be less than 16 characters long!
config ZMK_KEYBOARD_NAME
    default "Ergoslide"

config ZMK_SPLIT_ROLE_CENTRAL
    default y

endif

if SHIELD_ERGOSLIDE_LEFT || SHIELD_ERGOSLIDE_RIGHT

config ZMK_SPLIT
    default y

config ZMK_HID_INDICATORS
    default y

config ZMK_SPLIT_PERIPHERAL_HID_INDICATORS
    default y

config LED
    default y

config LED_GPIO
    default y

endif
```
