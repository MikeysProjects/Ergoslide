## boards/shields/ergoslide/Kconfig.shield
```kconfig
# No whitespace after the comma or in your part name!
config SHIELD_ERGOSLIDE_LEFT
    def_bool $(shields_list_contains,ergoslide_left)

# No whitespace after the comma or in your part name!
config SHIELD_ERGOSLIDE_RIGHT
    def_bool $(shields_list_contains,ergoslide_right)
```
